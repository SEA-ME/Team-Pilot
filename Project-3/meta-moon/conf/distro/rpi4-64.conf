## Project-3/meta-moon/conf/distro/rpi4-64.conf
```bitbake
# systemd
DISTRO_FEATURES:append = " systemd"
VIRTUAL-RUNTIME_init_manager = "systemd"
VIRTUAL-RUNTIME_initscripts = ""
DISTRO_FEATURES_BACKFILL_CONSIDERED = "sysvinit"
```

## Project-3/meta-moon/conf/layer.conf
```bitbake
# We have a conf and classes directory, add to BBPATH
BBPATH .= ":${LAYERDIR}"

# We have recipes-* directories, add to BBFILES
BBFILES += "${LAYERDIR}/recipes-*/*/*.bb \
            ${LAYERDIR}/recipes-*/*/*.bbappend"

BBFILE_COLLECTIONS += "meta-moon"
BBFILE_PATTERN_meta-moon = "^${LAYERDIR}/"
BBFILE_PRIORITY_meta-moon = "6"

LAYERDEPENDS_meta-moon = "core"
LAYERSERIES_COMPAT_meta-moon = "kirkstone"
```

## Project3/build/raspberrypi4/conf/bblayers.conf
```bitbake
# POKY_BBLAYERS_CONF_VERSION is increased each time build/conf/bblayers.conf
# changes incompatibly
POKY_BBLAYERS_CONF_VERSION = "2"

BBPATH = "${TOPDIR}"
BBFILES ?= ""

BBLAYERS ?= " \
  /home/seame-fablab/yocto/kirkstone/poky/meta \
  /home/seame-fablab/yocto/kirkstone/poky/meta-poky \
  /home/seame-fablab/yocto/kirkstone/poky/meta-yocto-bsp \
  /home/seame-fablab/yocto/kirkstone/meta-openembedded/meta-oe \
  /home/seame-fablab//yocto/kirkstone/meta-openembedded/meta-multimedia \
  /home/seame-fablab/yocto/kirkstone/meta-openembedded/meta-networking \
  /home/seame-fablab/yocto/kirkstone/meta-openembedded/meta-python \
  /home/seame-fablab/yocto/kirkstone/meta-raspberrypi \
  /home/seame-fablab/yocto/kirkstone/meta-qt5 \
  /home/seame-fablab/yocto/kirkstone/meta-qt6 \
  /home/seame-fablab/yocto/kirkstone/meta-myqt \
  /home/seame-fablab/yocto/kirkstone/meta-splash \
  "
```

## Project3/meta-myqt/conf/layer.conf
```bitbake
# We have a conf and classes directory, add to BBPATH
BBPATH .= ":${LAYERDIR}"

# We have recipes-* directories, add to BBFILES
BBFILES += "${LAYERDIR}/recipes-*/*/*.bb \
            ${LAYERDIR}/recipes-*/*/*.bbappend"

BBFILE_COLLECTIONS += "meta-myqt"
BBFILE_PATTERN_meta-myqt = "^${LAYERDIR}/"
BBFILE_PRIORITY_meta-myqt = "6"

LAYERDEPENDS_meta-myqt = "core"
LAYERSERIES_COMPAT_meta-myqt = "kirkstone"
```
